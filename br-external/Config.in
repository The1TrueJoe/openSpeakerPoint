## br-external/package/example-daemon/Config.in
```kconfig
config BR2_PACKAGE_EXAMPLE_DAEMON
	bool "example-daemon"
	help
	  Minimal placeholder app (apps/example-daemon) demonstrating how
	  custom SpeakerPoint applications, developed under apps/ in this
	  same repo, are wired into the Buildroot package system. Copy
	  this package directory as a starting template for real apps -
	  see apps/README.md.
```

## image/package/ep93xx-ac97/Config.in
```kconfig
config BR2_PACKAGE_EP93XX_AC97
	bool "ep93xx-ac97"
	depends on BR2_LINUX_KERNEL
	help
	  Out-of-tree kernel modules providing:
	    ep93xx-ac97.ko     - EP93xx AC97 controller ASoC CPU DAI driver
	                         (ported from the v5.8 in-tree driver that was
	                         removed when its board users were deleted).
	    speakerpoint-card.ko - ASoC machine/card driver wiring the EP93xx
	                         AC97 controller to the STAC9758 codec on the
	                         Control4 SpeakerPoint PCB.

	  Requires CONFIG_MODULES=y and CONFIG_SND_SOC_AC97_CODEC=y in the
	  kernel configuration.
```

## image/package/speakerpoint-control/Config.in
```kconfig
config BR2_PACKAGE_SPEAKERPOINT_CONTROL
	bool "speakerpoint-control"
	select BR2_PACKAGE_MOSQUITTO
	help
	  HTTP + MQTT control daemon for the SpeakerPoint. Exposes JSON
	  endpoints for volume, output routing (RCA line-out vs. the
	  powered D2 amplifier), test tones, and USB MP3 playback with
	  ID3 metadata + album art. Drives the codec via ALSA, the amp
	  over I2C, and plays media via MPD. Live controls and state are
	  also on MQTT (libmosquitto), on the box's own broker.
```
